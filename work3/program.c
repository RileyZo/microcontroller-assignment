#include <reg51.h>
#include <intrins.h>

unsigned char code rows[] = {0x7F, 0xBF, 0xDF, 0xEF, 0xF7, 0xFB, 0xFD, 0xFE};

unsigned char code columns[10][8] = {
    {0x3C,0x42,0x42,0x42,0x42,0x42,0x42,0x3C},
    {0x08,0x0C,0x08,0x08,0x08,0x08,0x08,0x1C},
    {0x3C,0x42,0x40,0x20,0x10,0x08,0x04,0x7E},
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    {0x3C,0x42,0x42,0x7C,0x40,0x40,0x42,0x3C}
};

unsigned int code id[] = {2, 4, 0, 2, 1, 7};

void delay(unsigned int times) {
    unsigned long ticks = 100 * times;
    while(ticks > 0) ticks--;
}

void main() {
    unsigned int index = 0;
    unsigned int row = 0;
    unsigned int latency = 10;
    
    while(1) {
        index = index % 6;
        row = row % 8;
        while(row < 8) {
            P2 = rows[row];
            P3 = columns[id[index]][row];
            delay(1);
            P3 = 0x00;
            row++;
        }

        if (latency > 0) {
            latency--;
        } else {
            latency = 10;
            index++;
        }
    }
}